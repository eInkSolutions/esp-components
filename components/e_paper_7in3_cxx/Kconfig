## components/e_paper_7in3_cxx/Kconfig
```kconfig
menu "7.3-inch E-Paper Configuration"

config EPD_BUSY_INTERRUPT_ENABLED
    bool "Enable BUSY GPIO interrupt"
    default n
    help
        Enable the BUSY GPIO interrupt for the 7.3-inch
        e-paper display.

        When enabled, the driver uses a GPIO interrupt to
        detect the BUSY -> IDLE transition of the display.

        When disabled, the driver will use polling instead.

endmenu
```

## components/sd_card_cxx/Kconfig
```kconfig
menu "SD Card Configuration"

    choice SDCARD_INTERFACE
        prompt "SD card interface"
        default SDCARD_INTERFACE_SDMMC_1BIT

        help
            Select the interface used to communicate with the SD card.

        config SDCARD_INTERFACE_SDMMC_1BIT
            bool "SDMMC 1-bit"

        config SDCARD_INTERFACE_SDMMC_4BIT
            bool "SDMMC 4-bit"

        config SDCARD_INTERFACE_SDSPI
            bool "SDSPI"

    endchoice

    menu "SDMMC Configuration"
        depends on SDCARD_INTERFACE_SDMMC_1BIT || SDCARD_INTERFACE_SDMMC_4BIT

        config SDCARD_SDMMC_CUSTOM_PINS
            bool "Use custom SDMMC GPIO pins"
            default false
            help
                Use manually configured GPIO pins for the SDMMC interface.
                If disabled, the default SDMMC pin configuration is used.

        config SDCARD_SDMMC_CLK_GPIO
            int "CLK GPIO"
            depends on SDCARD_SDMMC_CUSTOM_PINS
            default 14

        config SDCARD_SDMMC_CMD_GPIO
            int "CMD GPIO"
            depends on SDCARD_SDMMC_CUSTOM_PINS
            default 15

        config SDCARD_SDMMC_D0_GPIO
            int "D0 GPIO"
            depends on SDCARD_SDMMC_CUSTOM_PINS
            default 2

        config SDCARD_SDMMC_D1_GPIO
            int "D1 GPIO"
            depends on SDCARD_SDMMC_CUSTOM_PINS && SDCARD_INTERFACE_SDMMC_4BIT
            default 4

        config SDCARD_SDMMC_D2_GPIO
            int "D2 GPIO"
            depends on SDCARD_SDMMC_CUSTOM_PINS && SDCARD_INTERFACE_SDMMC_4BIT
            default 12

        config SDCARD_SDMMC_D3_GPIO
            int "D3 GPIO"
            depends on SDCARD_SDMMC_CUSTOM_PINS && SDCARD_INTERFACE_SDMMC_4BIT
            default 13

        config SDMMC_DEBUG_PIN_CONNECTIONS
            bool "Debug Pin Connections"
            default false

    endmenu

    menu "SDSPI Configuration"
        depends on SDCARD_INTERFACE_SDSPI

        config SDCARD_SDSPI_MOSI_GPIO
            int "MOSI GPIO"
            default 15

        config SDCARD_SDSPI_MISO_GPIO
            int "MISO GPIO"
            default 2

        config SDCARD_SDSPI_CLK_GPIO
            int "CLK GPIO"
            default 14

        config SDCARD_SDSPI_CS_GPIO
            int "CS GPIO"
            default 13

    endmenu

endmenu
```
